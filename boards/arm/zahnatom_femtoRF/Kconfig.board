## boards/arm/zahnatom_femtoRF/Kconfig.board
```kconfig
# Copyright (c) 2023 Nordic Semiconductor ASA
# SPDX-License-Identifier: Apache-2.0

config BOARD_ZAHNATOM_FEMTORF
	bool "zahnatom femtoRF"
	select SOC_DCDC_NRF52X
	depends on SOC_NRF52832_CIAA
```

## boards/arm/zahnatom_femtoRF/Kconfig.defconfig
```kconfig
# Copyright (c) 2023 Nordic Semiconductor ASA
# SPDX-License-Identifier: Apache-2.0

if BOARD_ZAHNATOM_FEMTORF

config BOARD
	default "zahnatom_femtoRF"

config BT_CTLR
   default BT

endif
```
